/*
 * CPU/RAM Show
 * For Nokia 3310 original display
 * By Gamiee (http://gamelaster.net/ or http://gamee.sk/)
 * */
#include <SPI.h>
#include <Adafruit_GFX.h>
#include <Adafruit_PCD8544.h>

Adafruit_PCD8544 display = Adafruit_PCD8544(3,4,5,7,6); //Pins of Arduino (For shield 7 6 5 4 3)

static const unsigned char PROGMEM image[] = {
	B00000000,B00000000,B00000000,B00000000,B00000000,B00000000,B00000000,B00000000,B00000000,B00000000,B0000,
	B00111000,B01000010,B00001000,B00000000,B00000000,B00000000,B00000000,B00000000,B00000000,B00000000,B0000,
	B00100100,B01100011,B00011000,B00000000,B00000000,B00000000,B00000000,B00000000,B00000000,B00000000,B0000,
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	B00000000,B00000000,B00000000,B00000000,B00000000,B00000000,B00000000,B00000000,B00000000,B00000000,B0000
};

void setup()
{
  display.begin();
  display.setContrast(50);
  display.clearDisplay();
  display.drawBitmap(0, 0,  image, 84, 48, 1);
  display.display();
  
  Serial.begin(9700);
}

String getValue(String data, char separator, int index)
{
  int found = 0;
  int strIndex[] = {0, -1};
  int maxIndex = data.length()-1;

  for(int i=0; i<=maxIndex && found<=index; i++){
    if(data.charAt(i)==separator || i==maxIndex){
        found++;
        strIndex[0] = strIndex[1]+1;
        strIndex[1] = (i == maxIndex) ? i+1 : i;
    }
  }

  return found>index ? data.substring(strIndex[0], strIndex[1]) : "";
}

void loop()
{
  if(Serial.available() > 0)
  {
    char cmd[50];
    String cmdtemp = Serial.readStringUntil('\n');
    display.clearDisplay();
    display.drawBitmap(0, 0,  image, 84, 48, 1);
    
    String percents = getValue(cmdtemp,';',0);
    int percent = percents.toInt();
    int percentage = round(0.74 * (double)percent);
    for(int i = 11; i < 19; i++)
      display.drawFastHLine(3,i,percentage,BLACK);
    display.setTextSize(1);
    display.setTextColor(BLACK);
    display.setCursor(60,1);//65
    char pertext[5];
    sprintf(pertext,"%d%s",percent,"%");
    display.println(pertext);
    
    String percents2 = getValue(cmdtemp,';',1);
    int percent2 = percents2.toInt();
    int percentage2 = round(0.74 * (double)percent2);
    for(int i = 36; i < 44; i++)
      display.drawFastHLine(3,i,percentage2,BLACK);
    display.setCursor(60,25);//65
    char pertext2[5];
    sprintf(pertext2,"%d%s",percent2,"%");
    display.println(pertext2);

    display.display();
  }
  
}
